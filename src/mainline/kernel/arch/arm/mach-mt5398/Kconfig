## src/mainline/kernel/arch/arm/mach-mt5398/Kconfig
```kconfig
# SPDX-License-Identifier: GPL-2.0
config ARCH_MT5398
	bool "MediaTek MT5398 (LG NetCast TVs)"
	depends on ARCH_MULTI_V7
	select ARM_GIC
	select ARM_GLOBAL_TIMER
	select HAVE_ARM_SCU if SMP
	help
	  MediaTek MT5398 TV SoC (2x Cortex-A9), as in LG NetCast 4.x TVs,
	  where the kernel is warm-booted from the stock one by nckexec.
	  Provides the "netcast,mt5398-smp" enable-method: the second core
	  is released from the hold page nckexec parks it in.
```

## src/mainline/kernel/drivers/media/platform/mediatek/mt5398/Kconfig
```kconfig
# SPDX-License-Identifier: GPL-2.0-only
config VIDEO_MT5398_VDEC
	tristate "MediaTek MT5398 H.264 decoder (LG NetCast TVs)"
	depends on V4L_MEM2MEM_DRIVERS
	depends on VIDEO_DEV && OF && HAS_DMA
	select MEDIA_CONTROLLER
	select VIDEOBUF2_DMA_CONTIG
	select VIDEOBUF2_VMALLOC
	select V4L2_MEM2MEM_DEV
	select V4L2_H264
	help
	  Stateless (frame-based) V4L2 H.264 decoder for the MT5398's video
	  decoder, up to 1920x1088, progressive only. Needs a CMA pool in
	  DRAM bank 0 (memory-region) and adds the decoder to LG's DRAM
	  write protection while it is bound.

config VIDEO_MT5398_VPLANE
	tristate "MediaTek MT5398 video plane (LG NetCast TVs)"
	depends on VIDEO_DEV && OF && HAS_DMA
	depends on DRM_MT5398_OSD || !DRM_MT5398_OSD
	select VIDEOBUF2_DMA_CONTIG
	select VIDEOBUF2_VMALLOC
	help
	  V4L2 video output device for the MT5398's video plane (B2R and
	  the main video path, mixed under the OSD): NV12 up to 1280x720
	  (tiled by the CPU, DMABUFs from mt5398-vdec imported without a
	  copy) or the decoder's own tiled format. Sets the path up for a
	  720p source itself and switches the desktop's OSD plane off while
	  a video streams.
```
